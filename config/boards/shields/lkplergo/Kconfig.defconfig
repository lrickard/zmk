## config/boards/shields/lkplergo/Kconfig.defconfig
```kconfig
if SHIELD_LKPLERGO_LEFT

config ZMK_KEYBOARD_NAME
    default "lkplergo"

config ZMK_SPLIT_ROLE_CENTRAL
    default y

endif

if SHIELD_LKPLERGO_LEFT || SHIELD_LKPLERGO_RIGHT

config ZMK_SPLIT
    default y

endif
```

## config/boards/shields/lkplergo/Kconfig.shield
```kconfig
config SHIELD_LKPLERGO_LEFT
    def_bool $(shields_list_contains,lkplergo_left)

config SHIELD_LKPLERGO_RIGHT
    def_bool $(shields_list_contains,lkplergo_right)
```
