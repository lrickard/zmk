// lkplergo_right.overlay

#include "lkplergo.dtsi"

&default_transform { // The matrix transform for this board is 7 columns over because the left half is 7 columns wide according to the matrix.
    col-offset = <7>;
};

&kscan0 {
    col-gpios
        = <&pro_micro 6 GPIO_ACTIVE_HIGH> // col1 in the schematic
        , <&pro_micro 21 GPIO_ACTIVE_HIGH> // col2 in the schematic
        , <&pro_micro 19 GPIO_ACTIVE_HIGH>  // col3 in the schematic
        , <&pro_micro 7 GPIO_ACTIVE_HIGH> // col4 in the schematic
        , <&pro_micro 3 GPIO_ACTIVE_HIGH> // col5 in the schematic
        , <&pro_micro 4 GPIO_ACTIVE_HIGH> // col6 in the schematic
        , <&pro_micro 5 GPIO_ACTIVE_HIGH> // col7 in the schematic
        ;
};